## Current_DEV/Antares_Open/zephyr/Kconfig
```kconfig
# Copyright (c) 2022 Brandon Satrom
# SPDX-License-Identifier: Apache-2.0

config USB_DEVICE_PID
	default USB_PID_CONSOLE_SAMPLE

source "Kconfig.zephyr"
```
